ZMK_LAYER(default_layer,
    // ╭────────────────┬───────────────┬───────────────┬────────────────┬────────────────┬────────────────╮       ╭────────────────┬────────────────┬────────────────┬────────────────┬────────────────┬────────────────╮
              XXX             XXX             XXX             XXX              XXX              XXX                      XXX              XXX              XXX              XXX              XXX              XXX
    // ├────────────────┼───────────────┼───────────────┼────────────────┼────────────────┼────────────────┤       ├────────────────┼────────────────┼────────────────┼────────────────┼────────────────┼────────────────┤
              XXX             XXX             XXX             XXX              XXX              XXX                      XXX              XXX              XXX              XXX              XXX              XXX 
    // ├────────────────┼───────────────┼───────────────┼────────────────┼────────────────┼────────────────┤       ├────────────────┼────────────────┼────────────────┼────────────────┼────────────────┼────────────────┤
              XXX             XXX             XXX             XXX              XXX              XXX                      XXX              XXX              XXX              XXX              XXX              XXX 
    // ╰────────────────┴───────────────┴───────────────┴────────────────┴────────────────┼────────────────┤       ├────────────────┼────────────────┼────────────────┴────────────────┴────────────────┴────────────────╯
                                                              ___              ___              ___                      ___              ___               XXX
    //                                                  ╰────────────────┴────────────────┴────────────────╯       ╰────────────────┴────────────────┴────────────────╯
)

