#define CONFIG_WIRELESS

#define X_LH  &trans
#define X_LB  &trans
#define X_LM  &trans
#define X_LT  &trans

#define X_RH  &trans
#define X_RB  &trans
#define X_RM  &trans
#define X_RT  &trans

#include "zmk-helpers/key-labels/42.h"
#include "base.keymap"

/{ chosen { zmk,physical-layout = &foostan_corne_6col_layout; }; };


