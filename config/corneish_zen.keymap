/* source key position labels */
#include "zmk-helpers/key-labels/42.h"

/* map Zen's extra keys */

#define X_LH  &lt SYS ESC   // thumb row, left
#define X_LB  &trans
#define X_LM  &trans
#define X_LT  &trans

#define X_RH  SMART_NUM    // thumb row, right
#define X_RB  &trans
#define X_RM  &smart_mouse
#define X_RT  &trans

/* activate bluetooth */
#define CONFIG_WIRELESS
#define ZMK_BASE_LAYER(name, LT, RT, LM, RM, LB, RB, LH, RH)                   \
    ZMK_LAYER(                                                                 \
        name,                                                                  \
                 LT RT                                                         \
                 LM RM                                                         \
                 LB RB                                                         \
        &kp LGUI LH RH &smart_mouse                                            \
    )

#include "zmk-helpers/key-labels/36.h"
#include "base.keymap"

/* use 6-column layout for Zen */
/{ chosen { zmk,physical-layout = &foostan_corne_6col_layout; }; };
